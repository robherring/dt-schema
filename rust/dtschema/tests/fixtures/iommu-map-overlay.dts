// SPDX-License-Identifier: BSD-2-Clause
// Copyright 2026 dt-schema contributors
/dts-v1/;
/plugin/;

/ {
    single-map {
        iommu-map = <0 &external_iommu 0 0x100 0x80>;
    };

    multiple-maps {
        iommu-map = <0 &external_iommu 0 0x100 0x80>,
                    <0x80 &external_iommu 0 0x200 0x80>;
    };

    wide-mapper {
        #iommu-cells = <2>;
        iommu-map = <0 0 &external_iommu 0 0x100 0x80>,
                    <0 0x80 &external_iommu 0 0x200 0x80>;
    };
};
